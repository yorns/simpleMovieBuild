## meta-app/conf/layer.conf
```bitbake
# We have a conf and classes directory, add to BBPATH
BBPATH .= ":${LAYERDIR}"

# We have recipes-* directories, add to BBFILES
BBFILES += "${LAYERDIR}/recipes-*/*/*.bb \
            ${LAYERDIR}/recipes-*/*/*.bbappend"

BBFILE_COLLECTIONS += "/workdir/sources/buildsystem/meta-app"
BBFILE_PATTERN_/workdir/sources/buildsystem/meta-app = "^${LAYERDIR}/"
BBFILE_PRIORITY_/workdir/sources/buildsystem/meta-app = "6"
```

## meta-rpic/conf/distro/rpic.conf
```bitbake
require conf/distro/poky.conf

DISTRO = "rpic"
DISTRO_NAME = "rpic distribution"
DISTRO_VERSION = "1.0"
DISTRO_CODENAME = "rpic"

## make omx player compile due to license restrictions
LICENSE_FLAGS_WHITELIST = "commercial"

## Enable wifi
DISTRO_FEATURES_append = " wifi"

## Enable systemd
# use systemd as init manager
DISTRO_FEATURES_append = " systemd"
VIRTUAL-RUNTIME_init_manager = "systemd"
# prevent the SysVinit distribution feature from being automatically enabled
DISTRO_FEATURES_BACKFILL_CONSIDERED = "sysvinit"
# remove initscripts from the image altogether
VIRTUAL-RUNTIME_initscripts = ""
```

## meta-rpic/conf/layer.conf
```bitbake
# We have a conf and classes directory, add to BBPATH
BBPATH .= ":${LAYERDIR}"

# We have recipes-* directories, add to BBFILES
BBFILES += "${LAYERDIR}/recipes-*/*/*.bb \
            ${LAYERDIR}/recipes-*/*/*.bbappend"

BBFILE_COLLECTIONS += "/workdir/sources/buildsystem/meta-rpic"
BBFILE_PATTERN_/workdir/sources/buildsystem/meta-rpic = "^${LAYERDIR}/"
BBFILE_PRIORITY_/workdir/sources/buildsystem/meta-rpic = "6"
```
